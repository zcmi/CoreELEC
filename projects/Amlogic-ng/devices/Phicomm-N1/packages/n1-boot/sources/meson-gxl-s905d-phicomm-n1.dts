// SPDX-License-Identifier: (GPL-2.0+ OR MIT)
/*
 * Copyright (c) 2019 Rural Hunter
 */

#include "gxl_p230_2g.dts"

/ {
	compatible = "phicomm,n1", "amlogic,s905d", "amlogic,meson-gxl";
	model = "Phicomm,N1";

	cvbs-connector {
		status = "disabled";
	};
};
